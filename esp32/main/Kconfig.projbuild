## esp32/main/Kconfig.projbuild
```kconfig
menu "MelodyPay wallet"

config MELODY_DEV_KEY_BACKEND
    bool "Development NVS key backend"
    default y
    help
        Development-only persistence path. This is not production key custody.

config MELODY_SECURE_ELEMENT_BACKEND
    bool "Secure element backend"
    default n
    help
        Must be implemented and reviewed before production signing.

config MELODY_ENABLE_MAINNET
    bool "Enable mainnet transaction support"
    default n
    help
        Mainnet remains unavailable unless this build-time gate and the
        runtime allow_mainnet opt-in are both enabled.

endmenu
```

## esp32/sdkconfig.defaults
```kconfig
CONFIG_IDF_TARGET="esp32s3"
CONFIG_ESPTOOLPY_FLASHSIZE_16MB=y
CONFIG_SPIRAM=y
CONFIG_SPIRAM_MODE_OCT=y
CONFIG_FREERTOS_UNICORE=n
CONFIG_LOG_DEFAULT_LEVEL_INFO=y
CONFIG_ESP_SYSTEM_PANIC_PRINT_REBOOT=y

# Development-only key backend. Production builds must disable this and use a
# secp256k1-capable secure element implementation.
CONFIG_MELODY_DEV_KEY_BACKEND=y
CONFIG_MELODY_SECURE_ELEMENT_BACKEND=n
CONFIG_MELODY_ENABLE_MAINNET=n
CONFIG_ESP_MAIN_TASK_STACK_SIZE=8192
CONFIG_MBEDTLS_ECP_C=y
CONFIG_MBEDTLS_ECDSA_C=y
CONFIG_MBEDTLS_ECP_DP_SECP256K1_ENABLED=y
CONFIG_MBEDTLS_ECDSA_DETERMINISTIC=y
```
