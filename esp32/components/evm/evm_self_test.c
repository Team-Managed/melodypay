#include "evm_self_test.h"

#include "evm_tx.h"
#include "keccak.h"

#include <string.h>

static const uint8_t abc_keccak[32] = {
    0x4e, 0x03, 0x65, 0x7a, 0xea, 0x45, 0xa9, 0x4f,
    0xc7, 0xd4, 0x7b, 0xa8, 0x26, 0xc8, 0xd6, 0x67,
    0xc0, 0xd1, 0xe6, 0xe3, 0x3a, 0x64, 0xa0, 0x36,
    0xec, 0x44, 0xf5, 0x8f, 0xa1, 0x2d, 0x6c, 0x45,
};

static const uint8_t golden_signature[65] = {
    0xae, 0x14, 0xff, 0xea, 0xca, 0x26, 0xe2, 0x2f,
    0x85, 0xa9, 0x95, 0xb8, 0x64, 0x6c, 0xa9, 0xa0,
    0xd1, 0x56, 0xdc, 0xd4, 0xec, 0x3a, 0xd8, 0x31,
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    0x00,
};

static const uint8_t golden_payload[] = {
    0x02, 0xf1, 0x82, 0x27, 0x9f, 0x07, 0x84, 0x77,
    0x35, 0x94, 0x00, 0x85, 0x22, 0xec, 0xb2, 0x5c,
    0x00, 0x82, 0x52, 0x08, 0x94,
    0x11, 0x11, 0x11, 0x11, 0x11, 0x11, 0x11, 0x11, 0x11, 0x11,
    0x11, 0x11, 0x11, 0x11, 0x11, 0x11, 0x11, 0x11, 0x11, 0x11,
    0x87, 0x23, 0x86, 0xf2,
    0x6f, 0xc1, 0x00, 0x00, 0x80, 0xc0,
};

static const uint8_t golden_digest[32] = {
    0xb3, 0x16, 0x94, 0x42, 0xa2, 0xa5, 0xc8, 0x20,
    0xb5, 0xfa, 0xfa, 0x73, 0x68, 0xec, 0xd9, 0xf6,
    0x6b, 0xa3, 0x7c, 0x46, 0x92, 0x04, 0x4f, 0x47,
    0x26, 0x3e, 0xfb, 0x9f, 0x38, 0x07, 0x68, 0x22,
};

static const uint8_t golden_transaction[] = {
    0x02, 0xf8, 0x74, 0x82, 0x27, 0x9f, 0x07, 0x84,
    0x77, 0x35, 0x94, 0x00, 0x85, 0x22, 0xec, 0xb2,
    0x5c, 0x00, 0x82, 0x52, 0x08, 0x94,
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    0x7b, 0xa8, 0x5c,
};

static const uint8_t empty_keccak[32] = {
    0xc5, 0xd2, 0x46, 0x01, 0x86, 0xf7, 0x23, 0x3c,
    0x92, 0x7e, 0x7d, 0xb2, 0xdc, 0xc7, 0x03, 0xc0,
    0xe5, 0x00, 0xb6, 0x53, 0xca, 0x82, 0x27, 0x3b,
    0x7b, 0xfa, 0xd8, 0x04, 0x5d, 0x85, 0xa4, 0x70,
};

static esp_err_t golden_signer(const uint8_t digest[32], uint8_t signature[65], size_t capacity)
{
    if (digest == NULL || signature == NULL || capacity < sizeof(golden_signature) ||
        memcmp(digest, golden_digest, sizeof(golden_digest)) != 0) {
        return ESP_ERR_INVALID_ARG;
    }
    memcpy(signature, golden_signature, sizeof(golden_signature));
    return ESP_OK;
}

esp_err_t evm_crypto_self_test(void)
{
    uint8_t digest[32];
    uint8_t payload[64];
    uint8_t transaction[128];
    size_t payload_length = 0;
    size_t transaction_length = 0;
    const evm_native_transfer_t transfer = {
        .chain_id = 10143,
        .recipient = {
            0x11, 0x11, 0x11, 0x11, 0x11, 0x11, 0x11, 0x11, 0x11, 0x11,
            0x11, 0x11, 0x11, 0x11, 0x11, 0x11, 0x11, 0x11, 0x11, 0x11,
        },
        .value = {
            0x00, 0x00, 0x00, 0x00, 0x00, 0x00, 0x00, 0x00,
            0x00, 0x00, 0x00, 0x00, 0x00, 0x00, 0x00, 0x00,
            0x00, 0x00, 0x00, 0x00, 0x00, 0x00, 0x00, 0x00,
            0x00, 0x23, 0x86, 0xf2, 0x6f, 0xc1, 0x00, 0x00,
        },
        .nonce = 7,
        .gas_limit = 21000,
        .max_priority_fee_per_gas = {
            0x00, 0x00, 0x00, 0x00, 0x00, 0x00, 0x00, 0x00,
            0x00, 0x00, 0x00, 0x00, 0x00, 0x00, 0x00, 0x00,
            0x00, 0x00, 0x00, 0x00, 0x00, 0x00, 0x00, 0x00,
            0x00, 0x00, 0x00, 0x00, 0x77, 0x35, 0x94, 0x00,
        },
        .max_fee_per_gas = {
            0x00, 0x00, 0x00, 0x00, 0x00, 0x00, 0x00, 0x00,
            0x00, 0x00, 0x00, 0x00, 0x00, 0x00, 0x00, 0x00,
            0x00, 0x00, 0x00, 0x00, 0x00, 0x00, 0x00, 0x00,
            0x00, 0x00, 0x00, 0x22, 0xec, 0xb2, 0x5c, 0x00,
        },
        .data_length = 0,
    };
    evm_keccak256(NULL, 0, digest);
    if (memcmp(digest, empty_keccak, sizeof(digest)) != 0) return ESP_FAIL;
    evm_keccak256((const uint8_t *)"abc", 3, digest);
    if (memcmp(digest, abc_keccak, sizeof(digest)) != 0) return ESP_FAIL;
    if (evm_encode_eip1559_signing_payload(&transfer, payload, sizeof(payload), &payload_length) != ESP_OK ||
        payload_length != sizeof(golden_payload) || memcmp(payload, golden_payload, payload_length) != 0) {
        return ESP_FAIL;
    }
    evm_signer_fn previous_signer = evm_current_signer();
    evm_register_signer(golden_signer);
    if (evm_sign_eip1559(&transfer, transaction, sizeof(transaction), &transaction_length) != ESP_OK ||
        transaction_length != sizeof(golden_transaction) ||
        memcmp(transaction, golden_transaction, transaction_length) != 0) {
        evm_register_signer(previous_signer);
        return ESP_FAIL;
    }
    evm_register_signer(previous_signer);
    return ESP_OK;
}
